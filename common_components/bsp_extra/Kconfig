## common_components/esp_cam_sensor/sensors/ov2640/Kconfig.ov2640
```kconfig
menuconfig CAMERA_OV2640
    bool "OV2640"
    default n
    help
        Enabling this option will add the support for OV2640.

if CAMERA_OV2640
    menuconfig CAMERA_OV2640_AUTO_DETECT
        bool "Auto detect OV2640"
        default y
        help
            When enabled, it provides the ability in application layer to automatically
            detect camera sensors one by one.

    if CAMERA_OV2640_AUTO_DETECT
        config CAMERA_OV2640_AUTO_DETECT_DVP_INTERFACE_SENSOR
            bool "Detect for DVP interface sensor"
            default y
            help
                When enabled, you don't need to call ov2640_detect manaually, ov5647
                will be automatically detected and connected to the DVP interface
                when the application starts.
    endif

    choice CAMERA_OV2640_DVP_DEFAULT_FMT
        prompt "Default format select"
        default CAMERA_OV2640_DVP_RGB565_640x480_6FPS
        help
            Select the default format to load when the sensor is detected.
            When the sensor is in stream off state, the format can be changed.
    
        config CAMERA_OV2640_DVP_RGB565_640x480_6FPS
            bool "RGB565 640x480 6fps, DVP 8bit 20M input"
        config CAMERA_OV2640_DVP_YUV422_640x480_6FPS
            bool "YUV422 640x480 6fps, DVP 8bit 20M input"
        config CAMERA_OV2640_DVP_JPEG_640x480_25FPS
            bool "JPEG 640x480 25fps, DVP 8bit 20M input"
        config CAMERA_OV2640_DVP_RGB565_240x240_25FPS
            bool "RGB565 240x240 25fps, DVP 8bit 20M input"
        config CAMERA_OV2640_DVP_YUV422_240x240_25FPS
            bool "YUV422 240x240 25fps, DVP 8bit 20M input"
        config CAMERA_OV2640_DVP_JPEG_320x240_50FPS
            bool "JPEG 320x240 50fps, DVP 8bit 20M input"
        config CAMERA_OV2640_DVP_JPEG_1280x720_12FPS
            bool "JPEG 1280x720 12fps, DVP 8bit 20M input"
        config CAMERA_OV2640_DVP_JPEG_1600x1200_12FPS
            bool "JPEG 1600x1200 12fps, DVP 8bit 20M input"
        config CAMERA_OV2640_DVP_RAW8_800x640_30FPS
            bool "RAW8 800x640 30fps, DVP 8bit 20M input"
        config CAMERA_OV2640_DVP_RAW8_800x640_15FPS
            bool "RAW8 800x640 15fps, DVP 8bit 20M input"
        config CAMERA_OV2640_DVP_RAW8_800x800_15FPS
            bool "RAW8 800x800 15fps, DVP 8bit 20M input"
        config CAMERA_OV2640_DVP_RAW8_1024x600_15FPS
            bool "RAW8 1024x600 15fps, DVP 8bit 20M input"
    endchoice # CAMERA_OV2640_DVP_DEFAULT_FMT

    config CAMERA_OV2640_DVP_IF_FORMAT_INDEX_DAFAULT
        int
        default 0 if CAMERA_OV2640_DVP_RGB565_640x480_6FPS
        default 1 if CAMERA_OV2640_DVP_YUV422_640x480_6FPS
        default 2 if CAMERA_OV2640_DVP_JPEG_640x480_25FPS
        default 3 if CAMERA_OV2640_DVP_RGB565_240x240_25FPS
        default 4 if CAMERA_OV2640_DVP_GRAY_320x240_20FPS
        default 5 if CAMERA_OV2640_DVP_YUV422_240x240_25FPS
        default 6 if CAMERA_OV2640_DVP_JPEG_320x240_50FPS
        default 7 if CAMERA_OV2640_DVP_JPEG_1280x720_12FPS
        default 8 if CAMERA_OV2640_DVP_RAW8_800x640_30FPS
        default 9 if CAMERA_OV2640_DVP_RAW8_800x640_15FPS
        default 10 if CAMERA_OV2640_DVP_RAW8_800x800_15FPS
        default 11 if CAMERA_OV2640_DVP_RAW8_1024x600_15FPS
        help
            Set the configuration loaded by default for the DVP interface.
            More information can be obtained by calling the query_support_formats().
endif
```

## common_components/esp_cam_sensor/sensors/ov2710/Kconfig.ov2710
```kconfig
menuconfig CAMERA_OV2710
    bool "OV2710"
    default n
    help
        Enabling this option will add the support for OV2710.

if CAMERA_OV2710
    menuconfig CAMERA_OV2710_AUTO_DETECT
        bool "Auto detect OV2710"
        default y
        help
            When enabled, it provides the ability in application layer to automatically
            detect camera sensors one by one.

    if CAMERA_OV2710_AUTO_DETECT
        config CAMERA_OV2710_AUTO_DETECT_MIPI_INTERFACE_SENSOR
            bool "Detect for MIPI interface sensor"
            default y
            help
                When enabled, you don't need to call ov2710_detect manaually, OV2710 will
                be automatically detected and connected to the MIPI CSI interface when
                the application starts.
    endif

    choice CAMERA_OV2710_MIPI_DEFAULT_FMT
        prompt "Default format select for MIPI"
        default CAMERA_OV2710_MIPI_RAW10_1920x1080_30FPS
        help
            Select the default format to load when the sensor is detected.
            When the sensor is in stream off state, the format can be changed.
    
        config CAMERA_OV2710_MIPI_RAW10_1920x1080_30FPS
            bool "RAW10 1920x1080 30fps, MIPI 1lane 24M input"
        config CAMERA_OV2710_MIPI_RAW10_1280x720_60FPS
            bool "RAW10 1280x720 60fps, MIPI 1lane 24M input"                               
    endchoice # CAMERA_OV2710_MIPI_DEFAULT_FMT

    config CAMERA_OV2710_MIPI_IF_FORMAT_INDEX_DAFAULT
        int
        default 0 if CAMERA_OV2710_MIPI_RAW10_1920x1080_30FPS
        default 1 if CAMERA_OV2710_MIPI_RAW10_1280x720_60FPS
        help
            Set the configuration loaded by default for the MIPI interface.
            More information can be obtained by calling the query_support_formats().
    
    config CAMERA_OV2710_STATS_UPDATE_EN
        bool "Refresh sensor statistics"
        default y
        help
            Enabling this option will start a timer to refresh sensor statistics.

    config CAMERA_OV2710_STATS_UPDATE_INTERVAL
        int "Stats update interval (millisecond)"
        range 0 2000
        default 120
        depends on CAMERA_OV2710_STATS_UPDATE_EN
        help
            The value indicates the interval used to update the statistical parameters of the camera sensor.

    choice CAMERA_OV2710_IPA_JSON_CONFIGURATION_FILE
        prompt "IPA JSON Configuration File"
        default CAMERA_OV2710_DEFAULT_IPA_JSON_CONFIGURATION_FILE
        help
            Select OV2710 JSON configuration file.

        config CAMERA_OV2710_DEFAULT_IPA_JSON_CONFIGURATION_FILE
            bool "Default"
            help
                Use the "esp_cam_sensor/sensors/ov2710/cfg/ov2710_default.json".

        config CAMERA_OV2710_CUSTOMIZED_IPA_JSON_CONFIGURATION_FILE
            bool "Customized"
            help
                Use a customized OV2710 JSON configuration file. Users should configure
                the file's path using the option "CAMERA_OV2710_CUSTOMIZED_IPA_JSON_CONFIGURATION_FILE_PATH."
    endchoice

    config CAMERA_OV2710_CUSTOMIZED_IPA_JSON_CONFIGURATION_FILE_PATH
        string "OV2710 Customized JSON Configuration File Path"
        depends on CAMERA_OV2710_CUSTOMIZED_IPA_JSON_CONFIGURATION_FILE
        help
            Customized OV2710 JSON configuration file's path and this path is evaluated
            relative to the project root directory by default.
endif
```

## common_components/esp_cam_sensor/sensors/ov5645/Kconfig.ov5645
```kconfig
menuconfig CAMERA_OV5645
    bool "OV5645"
    default n
    help
        Enabling this option will add the support for OV5645.

if CAMERA_OV5645
    menuconfig CAMERA_OV5645_AUTO_DETECT
        bool "Auto detect OV5645"
        default y
        help
            When enabled, it provides the ability in application layer to automatically
            detect camera sensors one by one.

    if CAMERA_OV5645_AUTO_DETECT
        config CAMERA_OV5645_AUTO_DETECT_MIPI_INTERFACE_SENSOR
            bool "Detect for MIPI interface sensor"
            default y
            help
                When enabled, you don't need to call ov5645_detect manaually, OV5645
                will be automatically detected and connected to the MIPI CSI interface
                when the application starts.
    endif

    choice CAMERA_OV5645_MIPI_DEFAULT_FMT
        prompt "Default format select"
        default CAMERA_OV5645_MIPI_YUV422_1280x960_30FPS
        help
            Select the default format to load when the sensor is detected.
            When the sensor is in stream off state, the format can be changed.
    
        config CAMERA_OV5645_MIPI_YUV422_1280x960_30FPS
            bool "YUV422 1280x960 30fps, MIPI 2lane 24M input"
        config CAMERA_OV5645_MIPI_RGB565_1280x960_30FPS
            bool "RGB565 1280x960 30fps, MIPI 2lane 24M input"
        config CAMERA_OV5645_MIPI_YUV420_1280x960_30FPS
            bool "YUV420 1280x960 30fps, MIPI 2lane 24M input"
        config CAMERA_OV5645_MIPI_YUV422_2592x1944_15FPS
            bool "YUV422 2592x1944 15fps, MIPI 2lane 24M input"
        config CAMERA_OV5645_MIPI_YUV422_1920x1080_15FPS
            bool "YUV422 1920x1080 15fps, MIPI 2lane 24M input"
        config CAMERA_OV5645_MIPI_YUV422_640x480_24FPS
            bool "YUV422 640x480 24fps, MIPI 2lane 24M input"
    endchoice # CAMERA_OV5645_MIPI_DEFAULT_FMT

    config CAMERA_OV5645_MIPI_IF_FORMAT_INDEX_DAFAULT
        int
        default 0 if CAMERA_OV5645_MIPI_YUV422_1280x960_30FPS
        default 1 if CAMERA_OV5645_MIPI_RGB565_1280x960_30FPS
        default 2 if CAMERA_OV5645_MIPI_YUV420_1280x960_30FPS
        default 3 if CAMERA_OV5645_MIPI_YUV422_2592x1944_15FPS
        default 4 if CAMERA_OV5645_MIPI_YUV422_1920x1080_15FPS
        default 5 if CAMERA_OV5645_MIPI_YUV422_640x480_24FPS
        help
            Set the configuration loaded by default for the MIPI interface.
            More information can be obtained by calling the query_support_formats().

    config CAMERA_OV5645_CSI_LINESYNC_ENABLE
        bool "CSI Line sync enable"
        default y
        help
            If enabled, send line short packet for each line.
endif
```

## common_components/esp_cam_sensor/sensors/ov5647/Kconfig.ov5647
```kconfig
menuconfig CAMERA_OV5647
    bool "OV5647"
    default n
    help
        Enabling this option will add the support for OV5647.

if CAMERA_OV5647
    menuconfig CAMERA_OV5647_AUTO_DETECT
        bool "Auto detect OV5647"
        default y
        help
            When enabled, it provides the ability in application layer to automatically
            detect camera sensors one by one.

    if CAMERA_OV5647_AUTO_DETECT
        config CAMERA_OV5647_AUTO_DETECT_MIPI_INTERFACE_SENSOR
            bool "Detect for MIPI interface sensor"
            default y
            help
                When enabled, you don't need to call ov5647_detect manaually, ov5647
                will be automatically detected and connected to the MIPI CSI interface
                when the application starts.
    endif

    choice CAMERA_OV5647_MIPI_DEFAULT_FMT
        prompt "Default format select"
        default CAMERA_OV5647_MIPI_RAW8_800x800_50FPS
        help
            Select the default format to load when the sensor is detected.
            When the sensor is in stream off state, the format can be changed.
    
        config CAMERA_OV5647_MIPI_RAW8_800x1280_50FPS
            bool "RAW8 800x1280 50fps, MIPI 2lane 24M input"
        config CAMERA_OV5647_MIPI_RAW8_800x640_50FPS
            bool "RAW8 800x640 50fps, MIPI 2lane 24M input"
        config CAMERA_OV5647_MIPI_RAW8_800x800_50FPS
            bool "RAW8 800x800 50fps, MIPI 2lane 24M input"
        config CAMERA_OV5647_MIPI_RAW10_1920x1080_30FPS
            bool "RAW10 1920x1080 30fps, MIPI 2lane 24M input"
        config CAMERA_OV5647_MIPI_RAW10_1280x960_BINNING_45FPS
            bool "RAW10 1280x960 Binning 45fps, MIPI 2lane 24M input"
    endchoice # CAMERA_OV5647_MIPI_DEFAULT_FMT

    config CAMERA_OV5647_MIPI_IF_FORMAT_INDEX_DAFAULT
        int
        default 0 if CAMERA_OV5647_MIPI_RAW8_800x1280_50FPS
        default 1 if CAMERA_OV5647_MIPI_RAW8_800x640_50FPS
        default 2 if CAMERA_OV5647_MIPI_RAW8_800x800_50FPS
        default 3 if CAMERA_OV5647_MIPI_RAW10_1920x1080_30FPS
        default 4 if CAMERA_OV5647_MIPI_RAW10_1280x960_BINNING_45FPS
        help
            Set the configuration loaded by default for the MIPI interface.
            More information can be obtained by calling the query_support_formats().

    config CAMERA_OV5647_CSI_LINESYNC_ENABLE
        bool "CSI Line sync enable"
        default y
        help
            If enabled, send line short packet for each line.

    config CAMERA_OV5647_ISP_AF_ENABLE
        bool "AF(auto focus) enable"
        default y
        help
            If enabled, the camera module will enable some IO pins to drive the
            VCM motor.

    choice CAMERA_OV5647_IPA_JSON_CONFIGURATION_FILE
        prompt "IPA JSON Configuration File"
        default CAMERA_OV5647_DEFAULT_IPA_JSON_CONFIGURATION_FILE
        help
            Select OV5647 JSON configuration file.

        config CAMERA_OV5647_DEFAULT_IPA_JSON_CONFIGURATION_FILE
            bool "Default"
            help
                Use the "esp_cam_sensor/sensors/ov5647/cfg/ov5647_default.json".

        config CAMERA_OV5647_CUSTOMIZED_IPA_JSON_CONFIGURATION_FILE
            bool "Customized"
            help
                Use a customized OV5647 JSON configuration file. Users should configure
                the file's path using the option "CAMERA_OV5647_CUSTOMIZED_IPA_JSON_CONFIGURATION_FILE_PATH."
    endchoice

    config CAMERA_OV5647_CUSTOMIZED_IPA_JSON_CONFIGURATION_FILE_PATH
        string "OV5647 Customized JSON Configuration File Path"
        depends on CAMERA_OV5647_CUSTOMIZED_IPA_JSON_CONFIGURATION_FILE
        help
            Customized OV5647 JSON configuration file's path and this path is evaluated
            relative to the project root directory by default.
endif
```

## common_components/esp_cam_sensor/sensors/sc030iot/Kconfig.sc030iot
```kconfig
menuconfig CAMERA_SC030IOT
    bool "SC030IOT"
    default n
    help
        Enabling this option will add the support for SC030IOT.

if CAMERA_SC030IOT
    menuconfig CAMERA_SC030IOT_AUTO_DETECT
        bool "Auto detect SC030IOT"
        default y
        help
            When enabled, it provides the ability in application layer to automatically
            detect camera sensors one by one.

    if CAMERA_SC030IOT_AUTO_DETECT
        config CAMERA_SC030IOT_AUTO_DETECT_DVP_INTERFACE_SENSOR
            bool "Detect for DVP interface sensor"
            default y
            help
                When enabled, you don't need to call sc030iot_detect manaually, SC030IOT will
                be automatically detected and connected to the DVP interface when the
                application starts.
    endif

    choice CAMERA_SC030IOT_DVP_DEFAULT_FMT
        prompt "Default format select"
        default CAMERA_SC030IOT_DVP_YUV422_640x480_26FPS
        help
            Select the default format to load when the sensor is detected.
            When the sensor is in stream off state, the format can be changed.
    
        config CAMERA_SC030IOT_DVP_YUV422_640x480_26FPS
            bool "YUV422 640x480 26fps, DVP 8bit 20M input"
        config CAMERA_SC030IOT_DVP_RAW8_640x480_26FPS
            bool "RAW8 640x480 26fps, DVP 8bit 20M input"
    endchoice # CAMERA_SC030IOT_DVP_DEFAULT_FMT

    config CAMERA_SC030IOT_DVP_IF_FORMAT_INDEX_DAFAULT
        int
        default 0 if CAMERA_SC030IOT_DVP_YUV422_640x480_26FPS
        default 1 if CAMERA_SC030IOT_DVP_RAW8_640x480_26FPS
        help
            Set the configuration loaded by default for the DVP interface.
            More information can be obtained by calling the query_support_formats().
endif
```
