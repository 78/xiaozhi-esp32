## common_components/bsp_extra/Kconfig
```kconfig
menu "Board Support Package"
    config BSP_I2S_NUM
        int "I2S peripheral index"
        default 1
        range 0 1
        help
            ESP32S3 has two I2S peripherals, pick the one you want to use.
endmenu
```

## common_components/esp32_p4_function_ev_board/Kconfig
```kconfig
menu "Board Support Package(ESP32-P4)"

    config BSP_ERROR_CHECK
        bool "Enable error check in BSP"
        default y
        help
            Error check assert the application before returning the error code.
            
    menu "I2C"
        config BSP_I2C_NUM
            int "I2C peripheral index"
            default 1
            range 0 1
            help
                ESP32P4 has two I2C peripherals, pick the one you want to use.

        config BSP_I2C_FAST_MODE
            bool "Enable I2C fast mode"
            default y
            help
                I2C has two speed modes: normal (100kHz) and fast (400kHz).

        config BSP_I2C_CLK_SPEED_HZ
            int
            default 400000 if BSP_I2C_FAST_MODE
            default 100000
    endmenu

    menu "I2S"
        config BSP_I2S_NUM
            int "I2S peripheral index"
            default 1
            range 0 2
            help
                ESP32P4 has three I2S peripherals, pick the one you want to use.
    endmenu

    menu "uSD card - Virtual File System"
        config BSP_SD_FORMAT_ON_MOUNT_FAIL
            bool "Format uSD card if mounting fails"
            default n
            help
                The SDMMC host will format (FAT) the uSD card if it fails to mount the filesystem.

        config BSP_SD_MOUNT_POINT
            string "uSD card mount point"
            default "/sdcard"
            help
                Mount point of the uSD card in the Virtual File System

    endmenu

    menu "SPIFFS - Virtual File System"
        config BSP_SPIFFS_FORMAT_ON_MOUNT_FAIL
            bool "Format SPIFFS if mounting fails"
            default n
            help
                Format SPIFFS if it fails to mount the filesystem.

        config BSP_SPIFFS_MOUNT_POINT
            string "SPIFFS mount point"
            default "/spiffs"
            help
                Mount point of SPIFFS in the Virtual File System.

        config BSP_SPIFFS_PARTITION_LABEL
            string "Partition label of SPIFFS"
            default "storage"
            help
                Partition label which stores SPIFFS.

        config BSP_SPIFFS_MAX_FILES
            int "Max files supported for SPIFFS VFS"
            default 5
            help
                Supported max files for SPIFFS in the Virtual File System.
    endmenu

    menu "Display"
        config BSP_LCD_DPI_BUFFER_NUMS
            int "Set number of frame buffers"
            default 1
            range 1 3
            help
                Let DPI LCD driver create a specified number of frame-size buffers. Only when it is set to multiple can the avoiding tearing be turned on.

        config BSP_DISPLAY_LVGL_AVOID_TEAR
            bool "Avoid tearing effect"
            depends on BSP_LCD_DPI_BUFFER_NUMS > 1
            default "n"
            help
                Avoid tearing effect through LVGL buffer mode and double frame buffers of RGB LCD. This feature is only available for RGB LCD.

        choice BSP_DISPLAY_LVGL_MODE
            depends on BSP_DISPLAY_LVGL_AVOID_TEAR
            prompt "Select LVGL buffer mode"
            default BSP_DISPLAY_LVGL_FULL_REFRESH
            config BSP_DISPLAY_LVGL_FULL_REFRESH
                bool "Full refresh"
            config BSP_DISPLAY_LVGL_DIRECT_MODE
                bool "Direct mode"
        endchoice
            
        config BSP_DISPLAY_BRIGHTNESS_LEDC_CH
        int "LEDC channel index"
        default 1
        range 0 7
        help
            LEDC channel is used to generate PWM signal that controls display brightness.
            Set LEDC index that should be used.

        choice BSP_LCD_COLOR_FORMAT
            prompt "Select LCD color format"
            default BSP_LCD_COLOR_FORMAT_RGB565
            help
                Select the LCD color format RGB565/RGB888.

            config BSP_LCD_COLOR_FORMAT_RGB565
                bool "RGB565"
            config BSP_LCD_COLOR_FORMAT_RGB888
                bool "RGB888"
        endchoice   
            
        choice BSP_LCD_TYPE
            prompt "Select LCD type"
            default BSP_LCD_TYPE_1280_800
            help
                Select the LCD.

            config BSP_LCD_TYPE_1024_600
                bool "LCD 7-inch 1024x600 - ek79007"
            config BSP_LCD_TYPE_1280_800
                bool "LCD 1280x800 - ili9881c"
        endchoice           
        
    endmenu
    
endmenu
```

## common_components/esp_cam_sensor/Kconfig
```kconfig
menu "Espressif Camera Sensors Configurations"
    menu "Camera Sensor Configuration"
        rsource "sensors/bf3925/Kconfig.bf3925"
        rsource "sensors/gc0308/Kconfig.gc0308"
        rsource "sensors/gc2145/Kconfig.gc2145"
        rsource "sensors/ov2640/Kconfig.ov2640"
        rsource "sensors/ov2710/Kconfig.ov2710"
        rsource "sensors/ov5645/Kconfig.ov5645"
        rsource "sensors/ov5647/Kconfig.ov5647"
        rsource "sensors/ov02c10/Kconfig.ov02c10"
        rsource "sensors/sc030iot/Kconfig.sc030iot"
        rsource "sensors/sc035hgs/Kconfig.sc035hgs"
        rsource "sensors/sc101iot/Kconfig.sc101iot"
        rsource "sensors/sc202cs/Kconfig.sc202cs"
        rsource "sensors/sc2336/Kconfig.sc2336"
    endmenu

    menu "Camera XCLK generator Configuration"
        config CAMERA_XCLK_USE_LEDC
            bool "XCLK generated by LEDC"
            default n if IDF_TARGET_ESP32P4
            default y
            help
                If enabled, XCLK can be generated from LEDC.
        
        config CAMERA_XCLK_USE_ESP_CLOCK_ROUTER
            bool "XCLK generated by ESP clock router"
            depends on IDF_TARGET_ESP32P4
            default y
            help
                If enabled, XCLK can be generated from SoC's supported root clocks. Please refer to SoC's supported root clocks at:
                `https://docs.espressif.com/projects/esp-idf/en/latest/esp32p4/api-reference/peripherals/clk_tree.html`
    endmenu

endmenu
```

## common_components/esp_cam_sensor/sensors/bf3925/Kconfig.bf3925
```kconfig
menuconfig CAMERA_BF3925
    bool "BF3925"
    default n
    help
        Enabling this option will add the support for BF3925.

if CAMERA_BF3925
    menuconfig CAMERA_BF3925_AUTO_DETECT
        bool "Auto detect BF3925"
        default y
        help
            When enabled, it provides the ability in application layer to automatically
            detect camera sensors one by one.

    if CAMERA_BF3925_AUTO_DETECT
        config CAMERA_BF3925_AUTO_DETECT_DVP_INTERFACE_SENSOR
            bool "Detect for DVP interface sensor"
            default y
            help
                When enabled, you don't need to call bf3925_detect manaually, BF3925 will
                be automatically detected and connected to the DVP interface when the
                application starts.
    endif

    choice CAMERA_BF3925_DVP_DEFAULT_FMT
        prompt "Default format select"
        default CAMERA_BF3925_DVP_YUV422_1600x1200_9FPS
        help
            Select the default format to load when the sensor is detected.
            When the sensor is in stream off state, the format can be changed.
    
        config CAMERA_BF3925_DVP_YUV422_1600x1200_9FPS
            bool "YUV422 1600x1200 9fps, DVP 8bit 20M input"
    endchoice # CAMERA_BF3925_DVP_DEFAULT_FMT

    config CAMERA_BF3925_DVP_IF_FORMAT_INDEX_DAFAULT
        int
        default 0 if CAMERA_BF3925_DVP_YUV422_1600x1200_9FPS
        help
            Set the configuration loaded by default for the DVP interface.
            More information can be obtained by calling the query_support_formats().
endif
```

## common_components/esp_cam_sensor/sensors/gc0308/Kconfig.gc0308
```kconfig
menuconfig CAMERA_GC0308
    bool "GC0308"
    default n
    help
        Enabling this option will add the support for GC0308.

if CAMERA_GC0308
    menuconfig CAMERA_GC0308_AUTO_DETECT
        bool "Auto detect GC0308"
        default y
        help
            When enabled, it provides the ability in application layer to automatically
            detect camera sensors one by one.

    if CAMERA_GC0308_AUTO_DETECT
        config CAMERA_GC0308_AUTO_DETECT_DVP_INTERFACE_SENSOR
            bool "Detect for DVP interface sensor"
            default y
            help
                When enabled, you don't need to call gc0308_detect manaually, GC0308 will
                be automatically detected and connected to the DVP interface when the
                application starts.
    endif

    choice CAMERA_GC0308_DVP_DEFAULT_FMT
        prompt "Default format select"
        default CAMERA_GC0308_DVP_YUV422_640x480_16FPS
        help
            Select the default format to load when the sensor is detected.
            When the sensor is in stream off state, the format can be changed.
    
        config CAMERA_GC0308_DVP_YUV422_640x480_16FPS
            bool "YUV422 640x480 16fps, DVP 8bit 20M input"
        config CAMERA_GC0308_DVP_RGB565_640x480_16FPS
            bool "RGB565 640x480 16fps, DVP 8bit 20M input"
        config CAMERA_GC0308_DVP_GRAY_640x480_16FPS
            bool "Grayscale 640x480 16fps, DVP 8bit 20M input"
        config CAMERA_GC0308_DVP_YUV422_320x240_20FPS
            bool "YUV422 320x240 20fps, DVP 8bit 20M input"
        config CAMERA_GC0308_DVP_GRAY_320x240_20FPS
            bool "Grayscale 320x240 20fps, DVP 8bit 20M input"
        config CAMERA_GC0308_DVP_RGB565_320x240_20FPS
            bool "RGB565 320x240 20fps, DVP 8bit 20M input"
    endchoice # CAMERA_GC0308_DVP_DEFAULT_FMT

    config CAMERA_GC0308_DVP_IF_FORMAT_INDEX_DAFAULT
        int
        default 0 if CAMERA_GC0308_DVP_YUV422_640x480_16FPS
        default 1 if CAMERA_GC0308_DVP_RGB565_640x480_16FPS
        default 2 if CAMERA_GC0308_DVP_GRAY_640x480_16FPS
        default 3 if CAMERA_GC0308_DVP_YUV422_320x240_20FPS
        default 4 if CAMERA_GC0308_DVP_GRAY_320x240_20FPS
        default 5 if CAMERA_GC0308_DVP_RGB565_320x240_20FPS
        help
            Set the configuration loaded by default for the DVP interface.
            More information can be obtained by calling the query_support_formats().
endif
```

## common_components/esp_cam_sensor/sensors/gc2145/Kconfig.gc2145
```kconfig
menuconfig CAMERA_GC2145
    bool "GC2145"
    default n
    help
        Enabling this option will add the support for GC2145.

if CAMERA_GC2145
    menuconfig CAMERA_GC2145_AUTO_DETECT
        bool "Auto detect GC2145"
        default y
        help
            When enabled, it provides the ability in application layer to automatically
            detect camera sensors one by one.

    if CAMERA_GC2145_AUTO_DETECT
        config CAMERA_GC2145_AUTO_DETECT_MIPI_INTERFACE_SENSOR
            bool "Detect for MIPI interface sensor"
            default y
            help
                When enabled, you don't need to call gc2145_detect manaually, GC2145 will
                be automatically detected and connected to the MIPI interface when the
                application starts.
    
        config CAMERA_GC2145_AUTO_DETECT_DVP_INTERFACE_SENSOR
        bool "Detect for DVP interface sensor"
        default n
        help
            When enabled, you don't need to call gc2145_detect manaually, GC2145 will
            be automatically detected and connected to the DVP interface when the
            application starts.
    endif

    choice CAMERA_GC2145_MIPI_DEFAULT_FMT
        prompt "Default format select"
        default CAMERA_GC2145_MIPI_RGB565_800x600_30FPS
        help
            Select the default format to load when the sensor is detected.
            When the sensor is in stream off state, the format can be changed.
    
        config CAMERA_GC2145_MIPI_RGB565_1600x1200_7FPS
            bool "RGB565 1600x1200 7fps, MIPI 1lane 24M input"
        config CAMERA_GC2145_MIPI_RGB565_800x600_30FPS
            bool "RGB565 800x600 30fps, MIPI 1lane 24M input"
    endchoice # CAMERA_GC2145_MIPI_DEFAULT_FMT

    config CAMERA_GC2145_MIPI_IF_FORMAT_INDEX_DAFAULT
        int
        default 0 if CAMERA_GC2145_MIPI_RGB565_1600x1200_7FPS
        default 1 if CAMERA_GC2145_MIPI_RGB565_800x600_30FPS
        help
            Set the configuration loaded by default for the MIPI interface.
            More information can be obtained by calling the query_support_formats().
    
    choice CAMERA_GC2145_DVP_DEFAULT_FMT
        prompt "Default format select for DVP"
        default CAMERA_GC2145_DVP_YUV422_640x480_15FPS
        help
            Select the default format to load when the sensor is detected.
            When the sensor is in stream off state, the format can be changed.
    
        config CAMERA_GC2145_DVP_YUV422_640x480_15FPS
            bool "YUV422 640x480 15fps, DVP 8bit 20M input"
        config CAMERA_GC2145_DVP_YUV422_1600x1200_13FPS
            bool "YUV422 1600x1200 13fps, DVP 8bit 20M input"
        config CAMERA_GC2145_DVP_YUV422_800x600_20FPS
            bool "YUV422 800x600 20fps, DVP 8bit 20M input"
    endchoice # CAMERA_GC2145_DVP_DEFAULT_FMT

    config CAMERA_GC2145_DVP_IF_FORMAT_INDEX_DAFAULT
        int
        default 2 if CAMERA_GC2145_DVP_YUV422_640x480_15FPS
        default 3 if CAMERA_GC2145_DVP_YUV422_1600x1200_13FPS
        default 4 if CAMERA_GC2145_DVP_YUV422_800x600_20FPS
        help
            Set the configuration loaded by default for the DVP interface.
            More information can be obtained by calling the query_support_formats().
endif
```
