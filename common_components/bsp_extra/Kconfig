## common_components/esp_video/Kconfig
```kconfig
menu "Espressif Video Configuration"

    config ESP_VIDEO_ENABLE_H264_VIDEO_DEVICE
        bool
        default n

    config ESP_VIDEO_ENABLE_JPEG_VIDEO_DEVICE
        bool
        default n

    config ESP_VIDEO_ENABLE_ISP
        bool
        default n

    config ESP_VIDEO_CHECK_PARAMETERS
        bool "Check Video Function Parameters"
        default y
        help
            Select this option, espressif video core functions will check
            input parameters.

    menuconfig ESP_VIDEO_ENABLE_MIPI_CSI_VIDEO_DEVICE
        bool "Enable MIPI-CSI based Video Device"
        depends on SOC_MIPI_CSI_SUPPORTED
        default y
        select ESP_VIDEO_ENABLE_ISP
        help
            Select this option, enable MIPI-CSI based video device.

    if ESP_VIDEO_ENABLE_MIPI_CSI_VIDEO_DEVICE

        config ESP_VIDEO_DISABLE_MIPI_CSI_DRIVER_BACKUP_BUFFER
            bool "Disable MIPI-CSI Driver Backup Buffer"
            default y
            help
                Select this option, esp-video disables MIPI-CSI driver backup buffer,
                and always reserves a block of video buffer for MIPI-CSI driver to
                receive data.

                In this mode, video buffer number must > 1.
    endif

    menuconfig ESP_VIDEO_ENABLE_DVP_VIDEO_DEVICE
        bool "Enable DVP based Video Device"
        depends on SOC_LCDCAM_CAM_SUPPORTED
        default y
        help
            Select this option, enable DVP based video device.

    menuconfig ESP_VIDEO_ENABLE_HW_H264_VIDEO_DEVICE
        bool "Enable Hardware H.264 based Video Device"
        depends on IDF_TARGET_ESP32P4
        select ESP_VIDEO_ENABLE_H264_VIDEO_DEVICE
        default n
        help
            Select this option, enable hardware H.264 based video device.

    menuconfig ESP_VIDEO_ENABLE_HW_JPEG_VIDEO_DEVICE
        bool "Enable Hardware JPEG based Video Device"
        depends on IDF_TARGET_ESP32P4
        select ESP_VIDEO_ENABLE_JPEG_VIDEO_DEVICE
        default n
        help
            Select this option, enable hardware JPEG based video device.

    menuconfig ESP_VIDEO_ENABLE_ISP_VIDEO_DEVICE
        bool "Enable ISP based Video Device"
        depends on SOC_ISP_SUPPORTED
        default y
        select ESP_VIDEO_ENABLE_ISP
        help
            Select this option, enable ISP based video device. When using
            camera sensor's internal ISP, this option can be disable.

    if ESP_VIDEO_ENABLE_ISP_VIDEO_DEVICE

        config ESP_VIDEO_ENABLE_ISP_PIPELINE_CONTROLLER
            bool "Enable ISP Pipeline Controller"
            default n
            help
                Select this option, enable ISP pipeline controller by creating
                the task "isp_task". This task reads statistics from the ISP
                statistics module, passes statistics to the image process algorithm
                module, and writes calculated data to the ISP or sensor.
    endif
endmenu
```

## common_components/esp_video/examples/capture_stream/main/Kconfig.projbuild
```kconfig
menu "Example Configuration"

    choice EXAMPLE_CAM_SENSOR_INTERFACE
        prompt "Camera sensor interface"
        default EXAMPLE_ENABLE_MIPI_CSI_CAM_SENSOR
        help
            Select camera sensor interface based on development board.

        config EXAMPLE_ENABLE_MIPI_CSI_CAM_SENSOR
            bool "MIPI-CSI"
            depends on ESP_VIDEO_ENABLE_MIPI_CSI_VIDEO_DEVICE

        config EXAMPLE_ENABLE_DVP_CAM_SENSOR
            bool "DVP"
            depends on ESP_VIDEO_ENABLE_DVP_VIDEO_DEVICE
    endchoice

    if EXAMPLE_ENABLE_MIPI_CSI_CAM_SENSOR
        config EXAMPLE_MIPI_CSI_SCCB_I2C_PORT
            int "MIPI CSI SCCB I2C Port Number"
            default 0
            range 0 1

        config EXAMPLE_MIPI_CSI_SCCB_I2C_SCL_PIN
            int "MIPI CSI SCCB I2C SCL Pin"
            default 34
            range -1 56

        config EXAMPLE_MIPI_CSI_SCCB_I2C_SDA_PIN
            int "MIPI CSI SCCB I2C SDA Pin"
            default 31
            range -1 56

        config EXAMPLE_MIPI_CSI_SCCB_I2C_FREQ
            int "MIPI CSI SCCB I2C Frequency"
            default 100000
            range 100000 400000
            help
                Increasing this value can reduce the initialization time of the camera sensor.
                Please refer to the relevant instructions of the camera sensor to adjust the value.

        config EXAMPLE_MIPI_CSI_CAM_SENSOR_RESET_PIN
            int "MIPI CSI Camera Sensor Reset Pin"
            default -1
            range -1 56

        config EXAMPLE_MIPI_CSI_CAM_SENSOR_PWDN_PIN
            int "MIPI CSI Camera Sensor Power Down Pin"
            default -1
            range -1 56
    endif

    if EXAMPLE_ENABLE_DVP_CAM_SENSOR
        config EXAMPLE_DVP_SCCB_I2C_PORT
            int "DVP SCCB I2C Port Number"
            default 1
            range 0 1

        config EXAMPLE_DVP_SCCB_I2C_SCL_PIN
            int "DVP SCCB I2C SCL Pin"
            default 33
            range -1 56

        config EXAMPLE_DVP_SCCB_I2C_SDA_PIN
            int "DVP SCCB I2C SDA Pin"
            default 32
            range -1 56

        config EXAMPLE_DVP_SCCB_I2C_FREQ
            int "DVP SCCB I2C Frequency"
            default 100000
            range 100000 400000
            help
                Increasing this value can reduce the initialization time of the camera sensor.
                Please refer to the relevant instructions of the camera sensor to adjust the value.

        config EXAMPLE_DVP_CAM_SENSOR_RESET_PIN
            int "DVP Camera Sensor Reset Pin"
            default -1
            range -1 56

        config EXAMPLE_DVP_CAM_SENSOR_PWDN_PIN
            int "DVP Camera Sensor Power Down Pin"
            default -1
            range -1 56

        config EXAMPLE_DVP_XCLK_FREQ
            int "DVP XCLK Frequency"
            default 20000000

        config EXAMPLE_DVP_XCLK_PIN
            int "DVP XCLK Pin"
            range 0 56
            default 20

        config EXAMPLE_DVP_PCLK_PIN
            int "DVP PCLK Pin"
            range 0 56
            default 21

        config EXAMPLE_DVP_VSYNC_PIN
            int "DVP VSYNC Pin"
            range 0 56
            default 23

        config EXAMPLE_DVP_DE_PIN
            int "DVP DE Pin"
            range 0 56
            default 22

        config EXAMPLE_DVP_D0_PIN
            int "DVP D0 Pin"
            range 0 56
            default 53

        config EXAMPLE_DVP_D1_PIN
            int "DVP D1 Pin"
            range 0 56
            default 54

        config EXAMPLE_DVP_D2_PIN
            int "DVP D2 Pin"
            range 0 56
            default 52

        config EXAMPLE_DVP_D3_PIN
            int "DVP D3 Pin"
            range 0 56
            default 1

        config EXAMPLE_DVP_D4_PIN
            int "DVP D4 Pin"
            range 0 56
            default 0

        config EXAMPLE_DVP_D5_PIN
            int "DVP D5 Pin"
            range 0 56
            default 45

        config EXAMPLE_DVP_D6_PIN
            int "DVP D6 Pin"
            range 0 56
            default 46

        config EXAMPLE_DVP_D7_PIN
            int "DVP D7 Pin"
            range 0 56
            default 47
    endif

    choice EXAMPLE_VIDEO_BUFFER_TYPE
        prompt "Video Buffer Type"
        default EXAMPLE_VIDEO_BUFFER_TYPE_USER
        depends on EXAMPLE_ENABLE_MIPI_CSI_CAM_SENSOR
        help
            Select video buffer type:
            
            - User buffer, users should allocate and free the buffer manually
            - Driver buffer, drivers allocate and free the buffer automatically

        config EXAMPLE_VIDEO_BUFFER_TYPE_USER
            bool "User Buffer"

        config EXAMPLE_VIDEO_BUFFER_TYPE_DRIVER
            bool "Driver Buffer"
    endchoice

    config EXAMPLE_ENABLE_CAM_SENSOR_PIC_VFLIP
        bool "Enable Camera Sensor Picture Vertical Flip"
        default n
        help
            Select this option, enable camera sensor picture vertical flip.

    config EXAMPLE_ENABLE_CAM_SENSOR_PIC_HFLIP
        bool "Enable Camera Sensor Picture Horizontal Flip"
        default n
        help
            Select this option, enable camera sensor picture horizontal flip.

endmenu
```

## common_components/esp_video/examples/simple_video_server/sdkconfig.defaults
```kconfig
CONFIG_SPIRAM=y

CONFIG_CAMERA_SC2336=y

CONFIG_IDF_EXPERIMENTAL_FEATURES=y

CONFIG_SPIRAM_SPEED_200M=y

CONFIG_LWIP_TCPIP_RECVMBOX_SIZE=64
CONFIG_LWIP_TCP_SND_BUF_DEFAULT=65535
CONFIG_LWIP_TCP_WND_DEFAULT=65535
CONFIG_LWIP_TCP_RECVMBOX_SIZE=64
```

## common_components/esp_video/examples/uvc/main/Kconfig.projbuild
```kconfig
menu "Example Configuration"

    choice EXAMPLE_CAM_SENSOR_INTERFACE
        prompt "Camera sensor interface"
        default EXAMPLE_CAM_SENSOR_MIPI_CSI
        help
            Select camera sensor interface based on development board.

        config EXAMPLE_CAM_SENSOR_MIPI_CSI
            bool "MIPI-CSI"
            depends on ESP_VIDEO_ENABLE_MIPI_CSI_VIDEO_DEVICE

        config EXAMPLE_CAM_SENSOR_DVP
            bool "DVP"
            depends on ESP_VIDEO_ENABLE_DVP_VIDEO_DEVICE
    endchoice

    if EXAMPLE_CAM_SENSOR_MIPI_CSI
        config EXAMPLE_MIPI_CSI_SCCB_I2C_PORT
            int "MIPI CSI SCCB I2C Port Number"
            default 0
            range 0 1

        config EXAMPLE_MIPI_CSI_SCCB_I2C_SCL_PIN
            int "MIPI CSI SCCB I2C SCL Pin"
            default 34
            range -1 56

        config EXAMPLE_MIPI_CSI_SCCB_I2C_SDA_PIN
            int "MIPI CSI SCCB I2C SDA Pin"
            default 31
            range -1 56

        config EXAMPLE_MIPI_CSI_SCCB_I2C_FREQ
            int "MIPI CSI SCCB I2C Frequency"
            default 100000
            range 100000 400000
            help
                Increasing this value can reduce the initialization time of the camera sensor.
                Please refer to the relevant instructions of the camera sensor to adjust the value.

        config EXAMPLE_MIPI_CSI_CAM_SENSOR_RESET_PIN
            int "MIPI CSI Camera Sensor Reset Pin"
            default -1
            range -1 56

        config EXAMPLE_MIPI_CSI_CAM_SENSOR_PWDN_PIN
            int "MIPI CSI Camera Sensor Power Down Pin"
            default -1
            range -1 56
    endif

    if EXAMPLE_CAM_SENSOR_DVP
        config EXAMPLE_DVP_SCCB_I2C_PORT
            int "DVP SCCB I2C Port Number"
            default 1
            range 0 1

        config EXAMPLE_DVP_SCCB_I2C_SCL_PIN
            int "DVP SCCB I2C SCL Pin"
            default 33
            range -1 56

        config EXAMPLE_DVP_SCCB_I2C_SDA_PIN
            int "DVP SCCB I2C SDA Pin"
            default 32
            range -1 56

        config EXAMPLE_DVP_SCCB_I2C_FREQ
            int "DVP SCCB I2C Frequency"
            default 100000
            range 100000 400000
            help
                Increasing this value can reduce the initialization time of the camera sensor.
                Please refer to the relevant instructions of the camera sensor to adjust the value.

        config EXAMPLE_DVP_CAM_SENSOR_RESET_PIN
            int "DVP Camera Sensor Reset Pin"
            default -1
            range -1 56

        config EXAMPLE_DVP_CAM_SENSOR_PWDN_PIN
            int "DVP Camera Sensor Power Down Pin"
            default -1
            range -1 56

        config EXAMPLE_DVP_XCLK_FREQ
            int "DVP XCLK Frequency"
            default 20000000

        config EXAMPLE_DVP_XCLK_PIN
            int "DVP XCLK Pin"
            range 0 56
            default 20

        config EXAMPLE_DVP_PCLK_PIN
            int "DVP PCLK Pin"
            range 0 56
            default 21

        config EXAMPLE_DVP_VSYNC_PIN
            int "DVP VSYNC Pin"
            range 0 56
            default 23

        config EXAMPLE_DVP_DE_PIN
            int "DVP DE Pin"
            range 0 56
            default 22

        config EXAMPLE_DVP_D0_PIN
            int "DVP D0 Pin"
            range 0 56
            default 53

        config EXAMPLE_DVP_D1_PIN
            int "DVP D1 Pin"
            range 0 56
            default 54

        config EXAMPLE_DVP_D2_PIN
            int "DVP D2 Pin"
            range 0 56
            default 52

        config EXAMPLE_DVP_D3_PIN
            int "DVP D3 Pin"
            range 0 56
            default 1

        config EXAMPLE_DVP_D4_PIN
            int "DVP D4 Pin"
            range 0 56
            default 0

        config EXAMPLE_DVP_D5_PIN
            int "DVP D5 Pin"
            range 0 56
            default 45

        config EXAMPLE_DVP_D6_PIN
            int "DVP D6 Pin"
            range 0 56
            default 46

        config EXAMPLE_DVP_D7_PIN
            int "DVP D7 Pin"
            range 0 56
            default 47
    endif

    if FORMAT_MJPEG_CAM1
        config EXAMPLE_JPEG_COMPRESSION_QUALITY
            int "JPEG Compression Quality"
            default 80
            range 1 100
            help
                JPEG compression quality, higher value means higher output
                image quality.
    endif

    if FORMAT_H264_CAM1
        config EXAMPLE_H264_I_PERIOD
            int "H.264 Intra Frame period"
            default 120
            range 1 120
            help
                H.264 I-Frame period.
        
        config EXAMPLE_H264_BITRATE
            int "H.264 Bitrate"
            default 1000000
            range 25000 2500000
            help
                H.264 bitrate.
        
        config EXAMPLE_H264_MIN_QP
            int "H.264 Minimum Quality"
            default 25
            range 1 51
            help
                H.264 minimum quality, the value should be less than H.264 maximum quality.

        config EXAMPLE_H264_MAX_QP
            int "H.264 Maximum Quality"
            default 26
            range 1 51
            help
                H.264 maximum quality, the value should be larger than H.264 minimum quality.
    endif
endmenu
```

## common_components/esp_video/examples/uvc/sdkconfig.defaults
```kconfig
CONFIG_ESP_VIDEO_ENABLE_HW_H264_VIDEO_DEVICE=y
CONFIG_ESP_VIDEO_ENABLE_HW_JPEG_VIDEO_DEVICE=y
CONFIG_FORMAT_H264_CAM1=y
CONFIG_UVC_CAM1_FRAMERATE=30
```

## common_components/esp_video/examples/uvc/sdkconfig.defaults.esp32p4
```kconfig
CONFIG_CAMERA_SC2336=y

CONFIG_IDF_EXPERIMENTAL_FEATURES=y

CONFIG_SPIRAM=y

CONFIG_SPIRAM_SPEED_200M=y
```
