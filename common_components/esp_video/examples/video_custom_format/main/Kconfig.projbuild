## common_components/esp_video/examples/video_custom_format/main/Kconfig.projbuild
```kconfig
menu "Example Configuration"

    config EXAMPLE_ENABLE_MIPI_CSI_CAM_SENSOR
        bool "Enable MIPI CSI Camera Sensor"
        default y
        depends on ESP_VIDEO_ENABLE_MIPI_CSI_VIDEO_DEVICE

    if EXAMPLE_ENABLE_MIPI_CSI_CAM_SENSOR
        config EXAMPLE_MIPI_CSI_SCCB_I2C_PORT
            int "MIPI CSI SCCB I2C Port Number"
            default 0
            range 0 1

        config EXAMPLE_MIPI_CSI_SCCB_I2C_SCL_PIN
            int "MIPI CSI SCCB I2C SCL Pin"
            default 8
            range -1 56

        config EXAMPLE_MIPI_CSI_SCCB_I2C_SDA_PIN
            int "MIPI CSI SCCB I2C SDA Pin"
            default 7
            range -1 56

        config EXAMPLE_MIPI_CSI_SCCB_I2C_FREQ
            int "MIPI CSI SCCB I2C Frequency"
            default 100000
            range 100000 400000
            help
                Increasing this value can reduce the initialization time of the camera sensor.
                Please refer to the relevant instructions of the camera sensor to adjust the value.

        config EXAMPLE_MIPI_CSI_CAM_SENSOR_RESET_PIN
            int "MIPI CSI Camera Sensor Reset Pin"
            default -1
            range -1 56

        config EXAMPLE_MIPI_CSI_CAM_SENSOR_PWDN_PIN
            int "MIPI CSI Camera Sensor Power Down Pin"
            default -1
            range -1 56
    endif

    config EXAMPLE_ENABLE_DVP_CAM_SENSOR
        bool "Enable DVP Camera Sensor"
        default n
        depends on ESP_VIDEO_ENABLE_DVP_VIDEO_DEVICE

    if EXAMPLE_ENABLE_DVP_CAM_SENSOR
        config EXAMPLE_DVP_SCCB_I2C_PORT
            int "DVP SCCB I2C Port Number"
            default 1
            range 0 1

        config EXAMPLE_DVP_SCCB_I2C_SCL_PIN
            int "DVP SCCB I2C SCL Pin"
            default 33
            range -1 56

        config EXAMPLE_DVP_SCCB_I2C_SDA_PIN
            int "DVP SCCB I2C SDA Pin"
            default 32
            range -1 56

        config EXAMPLE_DVP_SCCB_I2C_FREQ
            int "DVP SCCB I2C Frequency"
            default 100000
            range 100000 400000
            help
                Increasing this value can reduce the initialization time of the camera sensor.
                Please refer to the relevant instructions of the camera sensor to adjust the value.

        config EXAMPLE_DVP_CAM_SENSOR_RESET_PIN
            int "DVP Camera Sensor Reset Pin"
            default -1
            range -1 56

        config EXAMPLE_DVP_CAM_SENSOR_PWDN_PIN
            int "DVP Camera Sensor Power Down Pin"
            default -1
            range -1 56

        config EXAMPLE_DVP_XCLK_FREQ
            int "DVP XCLK Frequency"
            default 20000000

        config EXAMPLE_DVP_XCLK_PIN
            int "DVP XCLK Pin"
            range 0 56
            default 20

        config EXAMPLE_DVP_PCLK_PIN
            int "DVP PCLK Pin"
            range 0 56
            default 21

        config EXAMPLE_DVP_VSYNC_PIN
            int "DVP VSYNC Pin"
            range 0 56
            default 23

        config EXAMPLE_DVP_DE_PIN
            int "DVP DE Pin"
            range 0 56
            default 22

        config EXAMPLE_DVP_D0_PIN
            int "DVP D0 Pin"
            range 0 56
            default 53

        config EXAMPLE_DVP_D1_PIN
            int "DVP D1 Pin"
            range 0 56
            default 54

        config EXAMPLE_DVP_D2_PIN
            int "DVP D2 Pin"
            range 0 56
            default 52

        config EXAMPLE_DVP_D3_PIN
            int "DVP D3 Pin"
            range 0 56
            default 1

        config EXAMPLE_DVP_D4_PIN
            int "DVP D4 Pin"
            range 0 56
            default 0

        config EXAMPLE_DVP_D5_PIN
            int "DVP D5 Pin"
            range 0 56
            default 45

        config EXAMPLE_DVP_D6_PIN
            int "DVP D6 Pin"
            range 0 56
            default 46

        config EXAMPLE_DVP_D7_PIN
            int "DVP D7 Pin"
            range 0 56
            default 47
    endif

endmenu
```

## common_components/espressif__esp_lcd_jd9165/test_apps/sdkconfig.defaults
```kconfig
CONFIG_ESP_TASK_WDT_EN=n
CONFIG_FREERTOS_HZ=1000
CONFIG_FREERTOS_TIMER_TASK_STACK_DEPTH=4096
```

## common_components/espressif__esp_lcd_jd9165/test_apps/sdkconfig.defaults.esp32p4
```kconfig
CONFIG_COMPILER_OPTIMIZATION_PERF=y
CONFIG_SPIRAM=y
CONFIG_SPIRAM_SPEED_200M=y
CONFIG_IDF_EXPERIMENTAL_FEATURES=y
```

## components/lvgl_esp32_drivers/Kconfig
```kconfig
menu "LVGL ESP Drivers"

    rsource "lvgl_tft/Kconfig"

    rsource "lvgl_touch/Kconfig"

endmenu

menu "I2C Port Settings"
    depends on LV_I2C && !HAVE_I2C_MANAGER

    rsource "lvgl_i2c/Kconfig"

endmenu
```

## components/lvgl_esp32_drivers/lvgl_i2c/Kconfig
```kconfig
menu "I2C Port 0"

	config I2C_MANAGER_0_ENABLED
		bool "Enable I2C port 0"
		
	if I2C_MANAGER_0_ENABLED
		config I2C_MANAGER_0_SDA
			int "SDA (GPIO pin)"
		config I2C_MANAGER_0_SCL
			int "SCL (GPIO pin)"
		config I2C_MANAGER_0_FREQ_HZ
			int "Frequency (Hz)"
			default 400000
			range 100000 5000000
			help
				The clock speed in Hz. Ranges from 100000 (100 kHz) to
				5000000 (5 Mhz). I2C busses that involve external wires may
				have to be slower, and the real maximum speed the bus will
				support depends on the value of the pullup resistors and the
				design of the overall circuit. 
		config I2C_MANAGER_0_TIMEOUT
			int "R/W timeout (ms)"
			default 20
			range 10 1000
			help
				Timeout for I2C read and write operations. This does not
				include the time waiting for a lock.
		config I2C_MANAGER_0_LOCK_TIMEOUT
			int "Stale lock override (ms)"
			default 50
			range 10 1000
			help
				Timeout at which point an operation waiting for its turn on
				the port will assume that whatever set the lock has died and
				overrides it. Set this somewhat larger than the previous
				timeout.
		config I2C_MANAGER_0_PULLUPS
			bool "Use ESP32 built-in bus pull-up resistors"
			help
				The I2C bus needs resistors to make sure it's in a defined
				state when nobody is talking. Many circuits have external
				pullup resistors already and turning these on will increase
				power consumption slightly and may limit the speed your bus
				can attain. Try with these off first if you don't know.
	endif

endmenu


menu "I2C Port 1"
	
	config I2C_MANAGER_1_ENABLED
		bool "Enable I2C port 1"
		
	if I2C_MANAGER_1_ENABLED
		config I2C_MANAGER_1_SDA
			int "SDA (GPIO pin)"
		config I2C_MANAGER_1_SCL
			int "SCL (GPIO pin)"
		config I2C_MANAGER_1_FREQ_HZ
			int "Frequency (Hz)"
			default 1000000
			range 100000 5000000
			help
				The clock speed in Hz. Ranges from 100000 (100 kHz) to
				5000000 (5 Mhz). I2C busses that involve external wires may
				have to be slower, and the real maximum speed the bus will
				support depends on the value of the pullup resistors and the
				design of the overall circuit. 
		config I2C_MANAGER_1_TIMEOUT
			int "R/W timeout (ms)"
			default 20
			range 10 1000
			help
				Timeout for I2C read and write operations. This does not
				include the time waiting for a lock. Default should be fine.
		config I2C_MANAGER_1_LOCK_TIMEOUT
			int "Stale lock override (ms)"
			default 50
			help
				Timeout at which point an operation waiting for its turn on
				the port will assume that whatever set the lock has died and
				overrides it. Set this somewhat larger than the previous
				timeout. Default should be fine.
			range 30 1000
		config I2C_MANAGER_1_PULLUPS
			bool "Use ESP32 built-in bus pull-up resistors"
			help
				The I2C bus needs resistors to make sure it's in a defined
				state when nobody is talking. Many circuits have external
				pullup resistors already and turning these on will increase
				power consumption slightly and may limit the speed your bus
				can attain. Try with these off first if you don't know.
	endif

endmenu
```
