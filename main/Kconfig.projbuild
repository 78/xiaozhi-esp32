## main/Kconfig.projbuild
```kconfig
menu "Xiaozhi Assistant"

config OTA_URL
    string "Default OTA URL"
    default "https://api.tenclass.net/xiaozhi/ota/"
    help
        The application will access this URL to check for new firmwares and server address.

choice
    prompt "Flash Assets"
    default FLASH_DEFAULT_ASSETS
    help
        Select the assets to flash.

    config FLASH_NONE_ASSETS
        bool "Do not flash assets"
    config FLASH_DEFAULT_ASSETS
        bool "Flash Default Assets"
    config FLASH_CUSTOM_ASSETS
        bool "Flash Custom Assets"
endchoice

config CUSTOM_ASSETS_FILE
    depends on FLASH_CUSTOM_ASSETS
    string "Custom Assets File"
    default "assets.bin"
    help
        The custom assets file to flash.
        It can be a local file relative to the project directory or a remote url.

choice
    prompt "Default Language"
    default LANGUAGE_ZH_CN
    help
        Select device display language

    config LANGUAGE_ZH_CN
        bool "Chinese"
    config LANGUAGE_EN_US
        bool "English"
endchoice

choice BOARD_TYPE
    prompt "Board Type"
    default BOARD_TYPE_CX_ESP32S3
    help
        Board type. 开发板类型
     config BOARD_TYPE_CX_ESP32S3
        bool "cx_esp32s3"
        depends on IDF_TARGET_ESP32S3
endchoice

choice WAKE_WORD_TYPE
    prompt "Wake Word Implementation Type"
    default USE_AFE_WAKE_WORD if (IDF_TARGET_ESP32S3 || IDF_TARGET_ESP32P4) && SPIRAM
    default WAKE_WORD_DISABLED
    help
        Choose the type of wake word implementation to use

    config WAKE_WORD_DISABLED
        bool "Disabled"
        help
            Disable wake word detection

    config USE_ESP_WAKE_WORD
        bool "Wakenet model without AFE"
        depends on IDF_TARGET_ESP32C3 || IDF_TARGET_ESP32C5 || IDF_TARGET_ESP32C6 || (IDF_TARGET_ESP32 && SPIRAM)
        help
            Support ESP32 C3、ESP32 C5 与 ESP32 C6, and (ESP32 with PSRAM)

    config USE_AFE_WAKE_WORD
        bool "Wakenet model with AFE"
        depends on (IDF_TARGET_ESP32S3 || IDF_TARGET_ESP32P4) && SPIRAM
        help
            Support AEC if available, requires ESP32 S3 and PSRAM

endchoice

config SEND_WAKE_WORD_DATA
    bool "Send Wake Word Data"
    default y
    depends on USE_AFE_WAKE_WORD
    help
        Send wake word data to the server as the first message of the conversation and wait for response

config WAKE_WORD_DETECTION_IN_LISTENING
    bool "Enable Wake Word Detection in Listening Mode"
    default n
    depends on USE_AFE_WAKE_WORD
    help
        Enable wake word detection while in listening mode.
        When enabled, the device can detect wake word during listening,
        which allows interrupting the current conversation.
        When disabled (default), wake word detection is turned off during listening.

config USE_AUDIO_PROCESSOR
    bool "Enable Audio Noise Reduction"
    default y
    depends on (IDF_TARGET_ESP32S3 || IDF_TARGET_ESP32P4) && SPIRAM
    help
        Requires ESP32 S3 and PSRAM

config USE_DEVICE_AEC
    bool "Enable Device-Side AEC"
    default n
    depends on USE_AUDIO_PROCESSOR && BOARD_TYPE_CX_ESP32S3
    help
        To work properly, device-side AEC requires a clean output reference path from the speaker signal and physical acoustic isolation between the microphone and speaker.

config USE_SERVER_AEC
    bool "Enable Server-Side AEC (Unstable)"
    default n
    depends on USE_AUDIO_PROCESSOR
    help
        To work perperly, server-side AEC requires server support

menu "WiFi Configuration Method"
    help
        WiFi Configuration Method Selection
    config USE_HOTSPOT_WIFI_PROVISIONING
        bool "Hotspot"
        default y
        help
            Use WiFi Hotspot to transmit WiFi configuration data
    config USE_ACOUSTIC_WIFI_PROVISIONING
        bool "Acoustic"
        help
            Use audio signal to transmit WiFi configuration data

endmenu

config RECEIVE_CUSTOM_MESSAGE
    bool "Enable Custom Message Reception"
    default n
    help
        Enable custom message reception, allow the device to receive custom messages from the server (preferably through the MQTT protocol)

endmenu
```

## sdkconfig.defaults.esp32
```kconfig
CONFIG_ESPTOOLPY_FLASHSIZE_4MB=y
CONFIG_PARTITION_TABLE_CUSTOM_FILENAME="partitions/v2/4m.csv"
CONFIG_ESP_TASK_WDT_TIMEOUT_S=20
```

## sdkconfig.defaults.esp32c6
```kconfig
CONFIG_PARTITION_TABLE_CUSTOM_FILENAME="partitions/v2/16m_c3.csv"
CONFIG_ESPTOOLPY_FLASHMODE_QIO=y
```

## sdkconfig.defaults.esp32s31
```kconfig
CONFIG_ESPTOOLPY_FLASHMODE_QIO=y
CONFIG_ESPTOOLPY_FLASHFREQ_80M=y

CONFIG_ESP_DEFAULT_CPU_FREQ_MHZ_320=y

CONFIG_SPIRAM=y
CONFIG_SPIRAM_MODE_OCT=y
CONFIG_SPIRAM_SPEED_200M=y
CONFIG_SPIRAM_MALLOC_ALWAYSINTERNAL=1024
CONFIG_SPIRAM_MALLOC_RESERVE_INTERNAL=102400
CONFIG_SPIRAM_MEMTEST=n
CONFIG_MBEDTLS_EXTERNAL_MEM_ALLOC=y

CONFIG_ESP_WIFI_STATIC_RX_BUFFER_NUM=3
CONFIG_ESP_WIFI_DYNAMIC_RX_BUFFER_NUM=6
CONFIG_ESP_WIFI_RX_BA_WIN=3
CONFIG_LWIP_TCPIP_RECVMBOX_SIZE=16
CONFIG_MBEDTLS_DYNAMIC_FREE_CONFIG_DATA=y

CONFIG_SR_WN_WN9_NIHAOXIAOZHI_TTS=y

# Keep the camera DMA bounce buffer out of internal SRAM so AFE/WakeNet10
# still has a usable internal heap after boot.
CONFIG_CAMERA_PSRAM_DMA=y

CONFIG_ESP_SYSTEM_EVENT_TASK_STACK_SIZE=4096

CONFIG_USB_HOST_CONTROL_TRANSFER_MAX_SIZE=1536

# LVGL Graphics
CONFIG_LV_USE_SNAPSHOT=y
```
